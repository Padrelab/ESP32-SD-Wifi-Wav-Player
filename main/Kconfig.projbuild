## main/Kconfig.projbuild
```kconfig
menu "ESP32 WAV Player"

    config STORAGE_MOUNT_POINT
        string "SD card mount point"
        default "/sdcard"

    config PLAYER_WAV_PATH
        string "Loop WAV path"
        default "/sdcard/loop.wav"

    config PLAYER_READ_BUFFER_SIZE
        int "WAV read buffer size (bytes)"
        range 1024 32768
        default 6144

    config PLAYER_TASK_STACK_SIZE
        int "Playback task stack size"
        range 4096 16384
        default 6144

    config PLAYER_TASK_PRIORITY
        int "Playback task priority"
        range 1 24
        default 10

    config PLAYER_VOLUME_PERCENT
        int "Playback volume (%)"
        range 0 100
        default 90

    config PLAYER_RETRY_DELAY_MS
        int "Retry delay after playback error (ms)"
        range 250 30000
        default 2000

    config PLAYER_UPDATE_TIMEOUT_MS
        int "Wait for playback stop before update (ms)"
        range 1000 60000
        default 15000

    config PLAYER_SD_RECOVERY_RETRY_DELAY_MS
        int "Initial SD recovery retry delay (ms)"
        range 100 60000
        default 2000

    config PLAYER_SD_RECOVERY_MAX_RETRY_DELAY_MS
        int "Max SD recovery retry delay (ms)"
        range 1000 300000
        default 15000

    config PLAYER_SD_WAIT_FOR_MEDIA_POLL_MS
        int "Wait-for-media poll interval (ms)"
        range 1000 300000
        default 15000

    config PLAYER_SD_ACTIVE_RECOVERY_ATTEMPTS
        int "Immediate SD recovery attempts before wait-for-media"
        range 0 32
        default 3

    config PLAYER_SD_RETURN_SETTLE_DELAY_MS
        int "Wait after SD remount before media probe (ms)"
        range 0 10000
        default 500

    config PLAYER_SD_RETURN_STABLE_CHECKS
        int "Successful media probes required after SD remount"
        range 1 8
        default 3

    config PLAYER_SD_RETURN_STABLE_CHECK_INTERVAL_MS
        int "Interval between post-remount media probes (ms)"
        range 0 5000
        default 150

    config PLAYER_SD_RECOVERY_MIN_FREQUENCY_KHZ
        int "Minimum SD SPI frequency during recovery (kHz)"
        range 1000 20000
        default 4000

    config SD_SPI_PIN_MOSI
        int "SD SPI MOSI GPIO"
        default 11 if IDF_TARGET_ESP32S3
        default 11

    config SD_SPI_PIN_MISO
        int "SD SPI MISO GPIO"
        default 13 if IDF_TARGET_ESP32S3
        default 13

    config SD_SPI_PIN_SCLK
        int "SD SPI SCLK GPIO"
        default 12 if IDF_TARGET_ESP32S3
        default 12

    config SD_SPI_PIN_CS
        int "SD SPI CS GPIO"
        default 10 if IDF_TARGET_ESP32S3
        default 10

    config SD_SPI_FREQUENCY_KHZ
        int "SD SPI clock (kHz)"
        range 400 20000
        default 16000

    config I2S_DOUT_PIN
        int "I2S DOUT GPIO"
        default 4 if IDF_TARGET_ESP32S3
        default 4

    config I2S_BCLK_PIN
        int "I2S BCLK GPIO"
        default 5 if IDF_TARGET_ESP32S3
        default 5

    config I2S_WS_PIN
        int "I2S WS/LRCLK GPIO"
        default 6 if IDF_TARGET_ESP32S3
        default 6

    config I2S_MCLK_PIN
        int "I2S MCLK GPIO (-1 disables MCLK)"
        default -1

    config WIFI_AP_SSID
        string "SoftAP SSID"
        default "ESP32-WAV-Player"

    config WIFI_AP_PASSWORD
        string "SoftAP password (empty for open network)"
        default "wavplayer"

    config WIFI_AP_CHANNEL
        int "SoftAP channel"
        range 1 13
        default 6

    config WIFI_AP_MAX_CONNECTIONS
        int "SoftAP max clients"
        range 1 8
        default 4

endmenu
```

## sdkconfig.defaults
```kconfig
CONFIG_IDF_TARGET="esp32s3"
CONFIG_IDF_TARGET_ESP32S3=y
CONFIG_ESPTOOLPY_FLASHSIZE_4MB=y
CONFIG_ESPTOOLPY_FLASHSIZE="4MB"
CONFIG_PARTITION_TABLE_CUSTOM=y
CONFIG_PARTITION_TABLE_CUSTOM_FILENAME="partitions.csv"
CONFIG_COMPILER_OPTIMIZATION_SIZE=y
CONFIG_ESP_CONSOLE_USB_SERIAL_JTAG=y
CONFIG_LOG_DYNAMIC_LEVEL_CONTROL=y
CONFIG_LOG_TAG_LEVEL_IMPL_LINKED_LIST=y
# CONFIG_ESPTOOLPY_FLASH_MODE_AUTO_DETECT is not set
CONFIG_ESPTOOLPY_FLASHMODE_QIO=y
CONFIG_ESP_SLEEP_PSRAM_LEAKAGE_WORKAROUND=y
CONFIG_SPIRAM=y
CONFIG_SPIRAM_MODE_QUAD=y
CONFIG_SPIRAM_SPEED_40M=y
CONFIG_SPIRAM_BOOT_HW_INIT=y
CONFIG_SPIRAM_BOOT_INIT=y
CONFIG_SPIRAM_USE_MALLOC=y
CONFIG_SPIRAM_MALLOC_ALWAYSINTERNAL=16384
CONFIG_SPIRAM_MALLOC_RESERVE_INTERNAL=65536
CONFIG_PLAYER_READ_BUFFER_SIZE=6144
CONFIG_PLAYER_TASK_PRIORITY=10
CONFIG_SD_SPI_PIN_MOSI=11
CONFIG_SD_SPI_PIN_MISO=13
CONFIG_SD_SPI_PIN_SCLK=12
CONFIG_SD_SPI_PIN_CS=10
CONFIG_SD_SPI_FREQUENCY_KHZ=16000
CONFIG_I2S_DOUT_PIN=4
CONFIG_I2S_BCLK_PIN=5
CONFIG_I2S_WS_PIN=6
CONFIG_I2S_MCLK_PIN=-1
```

## sdkconfig.defaults.n16r8
```kconfig
CONFIG_ESPTOOLPY_FLASHSIZE_16MB=y
CONFIG_ESPTOOLPY_FLASHSIZE="16MB"
CONFIG_PARTITION_TABLE_CUSTOM=y
CONFIG_PARTITION_TABLE_CUSTOM_FILENAME="partitions_n16r8.csv"
CONFIG_SPIRAM=y
CONFIG_SPIRAM_MODE_OCT=y
CONFIG_SPIRAM_SPEED_80M=y
CONFIG_SPIRAM_BOOT_HW_INIT=y
CONFIG_SPIRAM_BOOT_INIT=y
CONFIG_SPIRAM_USE_MALLOC=y
CONFIG_SPIRAM_TRY_ALLOCATE_WIFI_LWIP=y
CONFIG_SPIRAM_MALLOC_ALWAYSINTERNAL=16384
CONFIG_SPIRAM_MALLOC_RESERVE_INTERNAL=65536
CONFIG_PLAYER_SD_RECOVERY_RETRY_DELAY_MS=2000
CONFIG_PLAYER_SD_RECOVERY_MAX_RETRY_DELAY_MS=15000
CONFIG_PLAYER_SD_WAIT_FOR_MEDIA_POLL_MS=15000
CONFIG_PLAYER_SD_ACTIVE_RECOVERY_ATTEMPTS=3
CONFIG_PLAYER_SD_RETURN_SETTLE_DELAY_MS=500
CONFIG_PLAYER_SD_RETURN_STABLE_CHECKS=3
CONFIG_PLAYER_SD_RETURN_STABLE_CHECK_INTERVAL_MS=150
CONFIG_SD_SPI_PIN_MOSI=11
CONFIG_SD_SPI_PIN_MISO=13
CONFIG_SD_SPI_PIN_SCLK=12
CONFIG_SD_SPI_PIN_CS=10
CONFIG_SD_SPI_FREQUENCY_KHZ=4000
CONFIG_PLAYER_SD_RECOVERY_MIN_FREQUENCY_KHZ=4000
CONFIG_I2S_DOUT_PIN=4
CONFIG_I2S_BCLK_PIN=5
CONFIG_I2S_WS_PIN=6
CONFIG_I2S_MCLK_PIN=-1
```
